## config/west.yml
```yaml
manifest:
  remotes:
    - name: zmkfirmware
      url-base: https://github.com/zmkfirmware
    - name: cosmicbuffalo
      url-base: https://github.com/cosmicbuffalo
  projects:
    - name: zmk
      remote: cosmicbuffalo
      revision: adv360-led
      import: app/west.yml
  self:
    path: config
```
